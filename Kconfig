## Kconfig
```kconfig
menu "Tensorflow Micro"
    config MCUX_COMPONENT_middleware.eiq.tensorflow_lite_micro
        bool "Enable TFLM"
    config MCUX_COMPONENT_middleware.eiq.tensorflow_lite_micro.refenerce
        bool "Enable TFLM refenerce kernel"
    config MCUX_COMPONENT_middleware.eiq.tensorflow_lite_micro.binary
        bool "Use TFLM lib"
        select MCUX_COMPONENT_middleware.eiq.tensorflow_lite_micro
        depends on !MCUX_COMPONENT_middleware.eiq.tensorflow_lite_micro.source
        depends on !MCUX_COMPONENT_middleware.eiq.tensorflow_lite_micro.library
    config MCUX_COMPONENT_middleware.eiq.tensorflow_lite_micro.source
        bool "Use TFLM source"
        select MCUX_COMPONENT_middleware.eiq.tensorflow_lite_micro
    config MCUX_COMPONENT_middleware.eiq.tensorflow_lite_micro.cmsis_nn
        bool "Enable cmsis_nn"
        select MCUX_COMPONENT_middleware.eiq.tensorflow_lite_micro
        depends on !MCUX_COMPONENT_middleware.eiq.tensorflow_lite_micro.binary
    config MCUX_COMPONENT_middleware.eiq.tensorflow_lite_micro.ethosu
        bool "Enable ethosu"
        select MCUX_COMPONENT_middleware.eiq.tensorflow_lite_micro
    config MCUX_COMPONENT_middleware.eiq.tensorflow_lite_micro.xtensa
        bool "Enable xtensa for DSP"
        select MCUX_COMPONENT_middleware.eiq.tensorflow_lite_micro
        depends on !MCUX_COMPONENT_middleware.eiq.tensorflow_lite_micro.binary
        depends on !MCUX_COMPONENT_middleware.eiq.tensorflow_lite_micro.cmsis_nn
    config MCUX_COMPONENT_middleware.eiq.tensorflow_lite_micro.neutron
        bool "Enable neutron"
        select MCUX_COMPONENT_middleware.eiq.tensorflow_lite_micro
    config MCUX_COMPONENT_middleware.eiq.tensorflow_lite_micro.library
        bool "Build TFLM library project"
        select MCUX_COMPONENT_middleware.eiq.tensorflow_lite_micro
        select MCUX_COMPONENT_middleware.eiq.tensorflow_lite_micro.source
    if MCUX_COMPONENT_middleware.eiq.tensorflow_lite_micro
        config MCUX_COMPONENT_middleware.eiq.tensorflow_lite_micro.debug_log
            bool "Use TFLM Debug_log"
            default y
            depends on !MCUX_COMPONENT_middleware.eiq.tensorflow_lite_micro.library
    endif
    config MCUX_COMPONENT_middleware.eiq.tensorflow_lite_micro.third_party.fft2d
        bool "Enable 3rdparty library fft2d"
endmenu
```
